#include <aifes.h>

#define FNN_LAYERS 4
#define DATASETS 226
#define TEST_DATASET 25
#define FEATURES 15

//FNN Structure with 15 neurons of input, two dense layer of 16 neurons each, an output layer with a single neuron
  uint32_t FNN_structure[FNN_LAYERS] = { FEATURES, 16, 16, 1 };

  //Train Data
  float trainX[DATASETS][FEATURES] = {
    { 0.0, 1.0, 0.7076923076923077, 0.9, 2.619796138467648e-09, 0.0, 0.0, 0.0, 0.0, 0.0, 0.01568627450980392, 0.01568627450980392, 0.0, 0.0, 0.0 },
    { 0.0, 0.5, 0.3384615384615385, 0.9, 5.684957620474796e-07, 3.63009171319946e-05, 0.0, 0.0, 1.0, 0.0, 0.00784313725490196, 0.00784313725490196, 0.0, 0.0, 0.0 },
    { 0.0, 0.5, 0.7076923076923077, 0.1, 0.0, 0.0, 0.0, 0.0, 0.0, 0.0, 0.00196078431372549, 0.0, 0.0, 0.0, 1.0 },
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    { 0.0, 0.5, 0.3384615384615385, 0.9, 6.785271998631209e-07, 0.022396695257683126, 0.0, 0.0, 1.0, 0.0, 0.0, 0.0, 0.0, 0.0, 0.0 }
};
  uint16_t input_shape[] = { DATASETS, (uint16_t)FNN_structure[0] };
  aitensor_t input_tensor = AITENSOR_2D_F32(input_shape, trainX);

  float trainY[DATASETS] = {0, 1, 0, 1, 1, 1, 1, 1, 1, 1, 1, 0, 0,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 0, 1 };
  uint16_t target_shape[] = { DATASETS, 1 };
  aitensor_t target_tensor = AITENSOR_2D_F32(target_shape, trainY);


  //Test Data
  float testX[TEST_DATASET][FEATURES] = {
    { 0.0, 0.5, 0.2923076923076923, 0.9, 9.693245712330298e-08, 0.0, 0.0, 0.0, 0.0, 0.0, 0.00196078431372549, 0.00196078431372549, 0.0, 0.0, 0.0 },
    { 0.0, 0.5, 0.3384615384615385, 0.7000000000000001, 6.182718886783649e-07, 0.0, 0.0, 0.025974025974025976, 1.0, 0.0, 0.0, 0.0, 1.0, 1.0, 0.0 },
    { 0.0, 0.5, 0.4307692307692308, 0.5, 0.0, 0.0, 0.0, 0.0, 0.0, 0.0, 0.23137254901960785, 0.021568627450980392, 1.0, 1.0, 0.0 },
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    { 0.0, 0.5, 0.2923076923076923, 0.9, 4.9776126630885315e-08, 0.0, 0.0, 0.0, 1.0, 0.0, 0.0, 0.0, 0.0, 0.0, 0.0 }
  };
  uint16_t test_input_shape[] = { TEST_DATASET, (uint16_t)FNN_structure[0] };
  aitensor_t test_input_tensor = AITENSOR_2D_F32(test_input_shape, testX);

  float testY[TEST_DATASET] = {1, 1, 0, 1, 1, 1, 0, 1, 1, 1, 1, 1, 0, 0, 0, 0, 1, 0, 1, 0, 1, 0, 0, 0, 1 };
  int16_t test_target_shape[] = { TEST_DATASET, 1 };
  aitensor_t test_target_tensor = AITENSOR_2D_F32(test_target_shape, testY);

  //Output
  float output_data[DATASETS];
  uint16_t output_shape[2] = { DATASETS, 1 };
  aitensor_t output_tensor = AITENSOR_2D_F32(output_shape, output_data);


void setup() {
  Serial.begin(115200);
  Serial.println("Program started");
  delay(500);
}
void loop() {
  create_fnn();
  delay(100000);
}
void create_fnn() {
  AIFES_E_activations FNN_activations[FNN_LAYERS - 1];
  FNN_activations[0] = AIfES_E_relu;     //AIfES_E_relu activation for first hidden (dense) layer
  FNN_activations[1] = AIfES_E_relu;     //AIfES_E_relu activation for second hidden (dense) layer
  FNN_activations[2] = AIfES_E_sigmoid;  //AIfES_E_sigmoid activation for output (dense) layer

  uint32_t weight_number = AIFES_E_flat_weights_number_fnn_f32(FNN_structure, FNN_LAYERS);

  //Serial.print(F("Weights: "));
  //Serial.println(weight_number);

  float FlatWeights[weight_number];

  AIFES_E_model_parameter_fnn_f32 FNN;
  FNN.layer_count = FNN_LAYERS;
  FNN.fnn_structure = FNN_structure;
  FNN.fnn_activations = FNN_activations;
  FNN.flat_weights = FlatWeights;

  AIFES_E_init_weights_parameter_fnn_f32 FNN_INIT_WEIGHTS;
  FNN_INIT_WEIGHTS.init_weights_method = AIfES_E_init_glorot_uniform;

  AIFES_E_training_parameter_fnn_f32 FNN_TRAIN;
  FNN_TRAIN.optimizer = AIfES_E_adam;
  FNN_TRAIN.loss = AIfES_E_crossentropy;

  FNN_TRAIN.learn_rate = 0.001;
  FNN_TRAIN.sgd_momentum = 0.0;  //Not using sgd
  FNN_TRAIN.batch_size = 64;
  FNN_TRAIN.epochs = 500;
  FNN_TRAIN.epochs_loss_print_interval = 10;

  FNN_TRAIN.loss_print_function = printLoss;
  FNN_TRAIN.early_stopping = AIfES_E_early_stopping_on;
  FNN_TRAIN.early_stopping_target_loss = 0.05;

  int8_t error = 0;  //Error Handling
  // -------------------------------- do the training ----------------------------------
  // In the training function, the FNN is set up, the weights are initialized and the training is performed.
  output_shape[0] = DATASETS;
  output_tensor = AITENSOR_2D_F32(output_shape, output_data);
  error = AIFES_E_training_fnn_f32(&input_tensor, &target_tensor, &FNN, &FNN_TRAIN, &FNN_INIT_WEIGHTS, &output_tensor);
  error_handling_training(error);
  // -------------------------------- do the inference ----------------------------------
  // AIfES Express function: do the inference
  output_shape[0] = TEST_DATASET;
  output_tensor = AITENSOR_2D_F32(output_shape, output_data);
  error = AIFES_E_inference_fnn_f32(&test_input_tensor, &FNN, &output_tensor);
  error_handling_inference(error); 
  //print_aitensor(&test_target_tensor);
  //print_aitensor(&output_tensor);


  Serial.println("");
  Serial.print("y_test = [");
  Serial.print(testY[0]);
  for(uint8_t i = 1 ; i < TEST_DATASET; i++){
    Serial.print(",");
    Serial.print(testY[i]);
  }
  Serial.print("]");

  Serial.println("");
  Serial.print("y_test_pred = np.array([");
  Serial.print(output_data[0]);
  for(uint8_t i = 1 ; i < TEST_DATASET; i++){
    Serial.print(",");
    Serial.print(output_data[i]);
  }
  Serial.print("])");

  output_shape[0] = DATASETS;
  output_tensor = AITENSOR_2D_F32(output_shape, output_data);
  error = AIFES_E_inference_fnn_f32(&input_tensor, &FNN, &output_tensor);
  error_handling_inference(error);
  //print_aitensor(&target_tensor);
  //print_aitensor(&output_tensor);

  Serial.println("");
  Serial.print("y_train = [");
  Serial.print(trainY[0]);
  for(uint8_t i = 1 ; i < DATASETS; i++){
    Serial.print(",");
    Serial.print(trainY[i]);
  }
  Serial.print("]");

  Serial.println("");
  Serial.print("y_train_pred = np.array([");
  Serial.print(output_data[0]);
  for(uint8_t i = 1 ; i < DATASETS; i++){
    Serial.print(",");
    Serial.print(output_data[i]);
  }
  Serial.print("])");

 
}
void printLoss(float loss) {
  if (!isnan(loss)) {
    Serial.print(F("Loss: "));
    Serial.println(loss, 5);
  }
}
void error_handling_training(int8_t error_nr) {
  switch (error_nr) {
    case 0:
      break;
    case -1:
      Serial.println(F("ERROR! Tensor dtype"));
      break;
    case -2:
      Serial.println(F("ERROR! Tensor shape: Data Number"));
      break;
    case -3:
      Serial.println(F("ERROR! Input tensor shape does not correspond to ANN inputs"));
      break;
    case -4:
      Serial.println(F("ERROR! Output tensor shape does not correspond to ANN outputs"));
      break;
    case -5:
      Serial.println(F("ERROR! Use the crossentropy as loss for softmax"));
      break;
    case -6:
      Serial.println(F("ERROR! learn_rate or sgd_momentum negative"));
      break;
    case -7:
      Serial.println(F("ERROR! Init uniform weights min - max wrong"));
      break;
    case -8:
      Serial.println(F("ERROR! batch_size: min = 1 / max = Number of training data"));
      break;
    case -9:
      Serial.println(F("ERROR! Unknown activation function"));
      break;
    case -10:
      Serial.println(F("ERROR! Unknown loss function"));
      break;
    case -11:
      Serial.println(F("ERROR! Unknown init weights method"));
      break;
    case -12:
      Serial.println(F("ERROR! Unknown optimizer"));
      break;
    case -13:
      Serial.println(F("ERROR! Not enough memory-t"));
      break;
    default:
      Serial.println(F("Unknown error"));
  }
}
void error_handling_inference(int8_t error_nr) {
  switch (error_nr) {
    case 0:
      break;
    case -1:
      Serial.println(F("ERROR! Tensor dtype"));
      break;
    case -2:
      Serial.println(F("ERROR! Tensor shape: Data Number"));
      break;
    case -3:
      Serial.println(F("ERROR! Input tensor shape does not correspond to ANN inputs"));
      break;
    case -4:
      Serial.println(F("ERROR! Output tensor shape does not correspond to ANN outputs"));
      break;
    case -5:
      Serial.println(F("ERROR! Unknown activation function"));
      break;
    case -6:
      Serial.println(F("ERROR! Not enough memory-i"));
      break;
    default:
      Serial.println(F("Unknown error"));
  }
}