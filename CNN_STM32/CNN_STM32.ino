#include <aifes.h>

#define FNN_LAYERS 4
#define DATASETS 256
#define TEST_DATASET 25
#define FEATURES 15


  //Train Data
  float trainX[DATASETS][FEATURES] = {
    { 0.0, 1.0, 0.7076923076923077, 0.9, 2.619796138467648e-09, 0.0, 0.0, 0.0, 0.0, 0.0, 0.01568627450980392, 0.01568627450980392, 0.0, 0.0, 0.0 },
    { 0.0, 0.5, 0.3384615384615385, 0.9, 5.684957620474796e-07, 3.63009171319946e-05, 0.0, 0.0, 1.0, 0.0, 0.00784313725490196, 0.00784313725490196, 0.0, 0.0, 0.0 },
    { 0.0, 0.5, 0.7076923076923077, 0.1, 0.0, 0.0, 0.0, 0.0, 0.0, 0.0, 0.00196078431372549, 0.0, 0.0, 0.0, 1.0 },
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    { 0.0, 0.5, 0.7076923076923077, 0.5, 0.0, 0.0, 0.0, 0.0, 0.0, 0.0, 0.49019607843137253, 0.025490196078431372, 1.0, 1.0, 0.0 }
};
  uint16_t input_shape[] = { DATASETS, FEATURES };
  aitensor_t input_tensor = AITENSOR_2D_F32(input_shape, trainX);

  float trainY[DATASETS] = {0, 1, 0, 1, 1, 1, 1, 1, 1, 1, 1, 0, 0,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 0, 0 };
  uint16_t target_shape[] = { DATASETS, 1 };
  aitensor_t target_tensor = AITENSOR_2D_F32(target_shape, trainY);


  //Test Data
  float testX[TEST_DATASET][FEATURES] = {
    { 0.0, 0.5, 0.2923076923076923, 0.9, 9.693245712330298e-08, 0.0, 0.0, 0.0, 0.0, 0.0, 0.00196078431372549, 0.00196078431372549, 0.0, 0.0, 0.0 },
    { 0.0, 0.5, 0.3384615384615385, 0.7000000000000001, 6.182718886783649e-07, 0.0, 0.0, 0.025974025974025976, 1.0, 0.0, 0.0, 0.0, 1.0, 1.0, 0.0 },
    { 0.0, 0.5, 0.4307692307692308, 0.5, 0.0, 0.0, 0.0, 0.0, 0.0, 0.0, 0.23137254901960785, 0.021568627450980392, 1.0, 1.0, 0.0 },
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    { 0.0, 0.5, 0.2923076923076923, 0.9, 4.9776126630885315e-08, 0.0, 0.0, 0.0, 1.0, 0.0, 0.0, 0.0, 0.0, 0.0, 0.0 }
  };
  uint16_t test_input_shape[] = { TEST_DATASET, FEATURES };
  aitensor_t test_input_tensor = AITENSOR_2D_F32(test_input_shape, testX);

  float testY[TEST_DATASET] = {1, 1, 0, 1, 1, 1, 0, 1, 1, 1, 1, 1, 0, 0, 0, 0, 1, 0, 1, 0, 1, 0, 0, 0, 1 };
  int16_t test_target_shape[] = { TEST_DATASET, 1 };
  aitensor_t test_target_tensor = AITENSOR_2D_F32(test_target_shape, testY);

  //Output
  float output_data[DATASETS];
  uint16_t output_shape[2] = { DATASETS, 1 };
  aitensor_t output_tensor = AITENSOR_2D_F32(output_shape, output_data);

void setup() {
  Serial.begin(115200);
  while (!Serial)
    ;
  uint32_t i;

  // ---------------------------------- Layer definition ---------------------------------------+
  uint16_t input_layer_shape[] = { 64, 1, FEATURES, 1 };  // [batch-size, channels, height, width]
  ailayer_input_f32_t input_layer = AILAYER_INPUT_F32_A(4, input_layer_shape);

  ailayer_conv2d_t conv2d_layer_1 = AILAYER_CONV2D_F32_A(/* filters =*/2, /* kernel_size =*/HW(3, 3), /* stride =*/HW(1, 1), /* dilation =*/HW(1, 1), /* padding =*/HW(1, 1));
  ailayer_batch_norm_f32_t bn_layer_1 = AILAYER_BATCH_NORM_F32_A(/* momentum =*/0.9f, /* eps =*/1e-6f);
  ailayer_relu_f32_t relu_layer_1 = AILAYER_RELU_F32_A();
  ailayer_maxpool2d_t maxpool2d_layer_1 = AILAYER_MAXPOOL2D_F32_A(/* pool_size =*/HW(2, 1), /* stride =*/HW(2, 1), /* padding =*/HW(0, 0));

  ailayer_conv2d_t conv2d_layer_2 = AILAYER_CONV2D_F32_A(/* filters =*/1, /* kernel_size =*/HW(3, 3), /* stride =*/HW(1, 1), /* dilation =*/HW(1, 1), /* padding =*/HW(1, 1));
  ailayer_batch_norm_f32_t bn_layer_2 = AILAYER_BATCH_NORM_F32_A(/* momentum =*/0.9f, /* eps =*/1e-6f);
  ailayer_relu_f32_t relu_layer_2 = AILAYER_RELU_F32_A();
  ailayer_maxpool2d_t maxpool2d_layer_2 = AILAYER_MAXPOOL2D_F32_A(/* pool_size =*/HW(2, 1), /* stride =*/HW(2, 1), /* padding =*/HW(0, 0));


  ailayer_conv2d_t conv2d_layer_3 = AILAYER_CONV2D_F32_A(/* filters =*/1, /* kernel_size =*/HW(3, 3), /* stride =*/HW(1, 1), /* dilation =*/HW(1, 1), /* padding =*/HW(1, 1));
  ailayer_batch_norm_f32_t bn_layer_3 = AILAYER_BATCH_NORM_F32_A(/* momentum =*/0.9f, /* eps =*/1e-6f);
  ailayer_relu_f32_t relu_layer_3 = AILAYER_RELU_F32_A();
  ailayer_maxpool2d_t maxpool2d_layer_3 = AILAYER_MAXPOOL2D_F32_A(/* pool_size =*/HW(2, 1), /* stride =*/HW(2, 1), /* padding =*/HW(0, 0));

  ailayer_flatten_t flatten_layer = AILAYER_FLATTEN_F32_A();
  ailayer_dense_f32_t dense_layer_1 = AILAYER_DENSE_F32_A(/* neurons =*/1);
  ailayer_sigmoid_f32_t sigmoid_layer_3 = AILAYER_SIGMOID_F32_A();

  ailoss_mse_f32_t mse_loss;

  // --------------------------- Define the structure of the model ----------------------------

  aimodel_t model;
  ailayer_t *x;

  model.input_layer = ailayer_input_f32_default(&input_layer);

  x = ailayer_conv2d_chw_f32_default(&conv2d_layer_1, model.input_layer);
  x = ailayer_batch_norm_cfirst_f32_default(&bn_layer_1, x);
  x = ailayer_relu_f32_default(&relu_layer_1, x);
  x = ailayer_maxpool2d_chw_f32_default(&maxpool2d_layer_1, x);

  x = ailayer_conv2d_chw_f32_default(&conv2d_layer_2, x);
  x = ailayer_batch_norm_cfirst_f32_default(&bn_layer_2, x);
  x = ailayer_relu_f32_default(&relu_layer_2, x);
  x = ailayer_maxpool2d_chw_f32_default(&maxpool2d_layer_2, x);

  x = ailayer_conv2d_chw_f32_default(&conv2d_layer_3, x);
  x = ailayer_batch_norm_cfirst_f32_default(&bn_layer_3, x);
  x = ailayer_relu_f32_default(&relu_layer_3, x);
  x = ailayer_maxpool2d_chw_f32_default(&maxpool2d_layer_3, x);

  x = ailayer_flatten_f32_default(&flatten_layer, x);
  x = ailayer_dense_f32_default(&dense_layer_1, x);
  x = ailayer_sigmoid_f32_default(&sigmoid_layer_3, x);
  model.output_layer = x;

  model.loss = ailoss_mse_f32_default(&mse_loss, model.output_layer);

  aialgo_compile_model(&model);

  Serial.print("-------------- Model structure ---------------\n");
  aialgo_print_model_structure(&model);
  Serial.print("----------------------------------------------\n\n");


  uint32_t parameter_memory_size = aialgo_sizeof_parameter_memory(&model);
  Serial.print(F("Required memory for parameter (Weights, Bias, ...): "));
  Serial.print(parameter_memory_size);
  Serial.print(F(" Byte\n"));
  void *parameter_memory = malloc(parameter_memory_size);
  if (!parameter_memory) {
    Serial.println("Failed to allocate parameter memory!");
    while (1)
      ;
  }

  // Distribute the memory to the trainable parameters of the model
  aialgo_distribute_parameter_memory(&model, parameter_memory, parameter_memory_size);

  // ------------------------------- Initialize the parameters ------------------------------

  srand(analogRead(A5));
  aialgo_initialize_parameters_model(&model);

  // -------------------------------- Define the optimizer for training ---------------------
  aiopti_t *optimizer;

  aiopti_adam_f32_t adam_opti = AIOPTI_ADAM_F32(0.01f, 0.9f, 0.999f, 1e-6f);
  optimizer = aiopti_adam_f32_default(&adam_opti);


  // -------------------------------- Allocate and schedule the working memory for training ---------

  uint32_t working_memory_size = aialgo_sizeof_training_memory(&model, optimizer);
  Serial.print(F("Required memory for training (Intermediate result, gradients, momentums): "));
  Serial.print(working_memory_size);
  Serial.print(F(" Byte\n"));

  void *working_memory = malloc(working_memory_size);
  if (!working_memory) {
    Serial.println("Failed to allocate working memory");
    while (1)
      ;
  }

  // Schedule the memory over the model
  aialgo_schedule_training_memory(&model, optimizer, working_memory, working_memory_size);

  aialgo_init_model_for_training(&model, optimizer);

  // ------------------------------------- Run the training ------------------------------------

  float loss;
  uint32_t batch_size = 64;
  uint32_t epochs = 500;

  Serial.println(F("Start training."));

  for (i = 0; i < epochs; i++) {
    // One epoch of training. Iterates through the whole data once
    aialgo_train_model(&model, &input_tensor, &target_tensor, optimizer, batch_size);

    // Calculate and print loss every 10 epochs
    if (i % 10 == 0) {
      aialgo_calc_loss_model_f32(&model, &input_tensor, &target_tensor, &loss);
      Serial.print(F("Epoch "));
      Serial.print(i);
      Serial.print(F(": loss: "));
      Serial.println(loss, 5);
    }
  }

  // ----------------------------------------- Evaluate the trained model --------------------------

  Serial.print(F("\nResults after training:\n"));

  output_shape[0] = DATASETS;
  output_tensor = AITENSOR_2D_F32(output_shape, output_data);
  aialgo_inference_model(&model, &input_tensor, &output_tensor);

  /*
  Serial.println(F("\n+++ Training data +++"));
  Serial.print(F("Predicted values:\n"));
  print_aitensor(&output_tensor);
  Serial.print(F("Target values:\n"));
  print_aitensor(&target_tensor);
  */

  Serial.println("");
  Serial.print("y_train = [");
  Serial.print(trainY[0]);
  for (uint16_t i = 1; i < DATASETS; i++) {
    Serial.print(",");
    Serial.print(trainY[i]);
  }
  Serial.print("]");

  Serial.println("");
  Serial.print("y_train_pred = np.array([");
  Serial.print(output_data[0]);
  for (uint16_t i = 1; i < DATASETS; i++) {
    Serial.print(",");
    Serial.print(output_data[i]);
  }
  Serial.print("])");

  output_shape[0] = TEST_DATASET;
  output_tensor = AITENSOR_2D_F32(output_shape, output_data);
  aialgo_inference_model(&model, &test_input_tensor, &output_tensor);


  /*
  Serial.println(F("\n+++ Test data +++"));
  Serial.print(F("Predicted values:\n"));
  print_aitensor(&output_tensor);
  Serial.print(F("Target values:\n"));
  print_aitensor(&test_target_tensor);
  */

  Serial.println("");
  Serial.print("y_test = [");
  Serial.print(testY[0]);
  for (uint8_t i = 1; i < TEST_DATASET; i++) {
    Serial.print(",");
    Serial.print(testY[i]);
  }
  Serial.print("]");

  Serial.println("");
  Serial.print("y_test_pred = np.array([");
  Serial.print(output_data[0]);
  for (uint8_t i = 1; i < TEST_DATASET; i++) {
    Serial.print(",");
    Serial.print(output_data[i]);
  }
  Serial.print("])");

  free(working_memory);
  free(parameter_memory);
  return;
}

void loop() {
}
